## Kconfig
```kconfig
# put here your custom config value
menu "Wifi STA Manual Access"

config ESP_WIFI_STA_SSID_PRI
    string "WiFi SSID Primary"
    default "empty"
    help
	STA SSID (network name) for the example to connect to.

config ESP_WIFI_STA_PASSWORD_PRI
    string "WiFi Password Primary"
    default "empty"
    help
	WiFi station password (WPA or WPA2).
   
endmenu

menu "Wifi Simple Network Time Protocol Settings"

config SNTP_TIME_ZONE
    string "Time Zone"
    default "EST5EDT"
    help
    https://sites.google.com/a/usapiens.com/opnode/time-zones
    
endmenu
```
